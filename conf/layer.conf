## conf/layer.conf
```bitbake
#
# Copyright (C) 2017-2019 Wind River Systems, Inc.
#
BBFILE_COLLECTIONS += "wr-ota-dl"
BBFILE_PATTERN_wr-ota-dl = ""
BBFILE_PATTERN_IGNORE_EMPTY_wr-ota-dl = "1"

# This should only be incremented on significant changes that will
# cause compatibility issues with other layers
LAYERVERSION_wr-ota-dl = "1"

LAYERSERIES_COMPAT_wr-ota-dl = "kirkstone"

# We have a pre-populated downloads directory, add to PREMIRRORS
PREMIRRORS:append = " \
     .*://.*/.* file://${LAYERDIR}/downloads/ \n \
     git://.*/.* git://${LAYERDIR}/git/MIRRORNAME;protocol=file \n \
"
```
